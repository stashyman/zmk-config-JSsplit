## config/boards/shields/JSsplit/Kconfig.defconfig
```kconfig
if SHIELD_JSSPLIT_LEFT

# Name must be less than 16 characters long!
config ZMK_KEYBOARD_NAME
    default "JSsplit"

config ZMK_SPLIT_ROLE_CENTRAL
    default y

config ZMK_SPLIT_BLE_CENTRAL_PERIPHERALS
  default 1

config BT_MAX_CONN
  default 6

config BT_MAX_PAIRED
  default 6

endif


if SHIELD_JSSPLIT_LEFT || SHIELD_JSSPLIT_RIGHT

config ZMK_SPLIT
    default y

config ZMK_POINTING
    default y

endif

if SHIELD_CENTRAL_DONGLE

config ZMK_KEYBOARD_NAME
    default "JSsplit"

config ZMK_POINTING
    default y

config ZMK_SPLIT
    default y

config ZMK_SPLIT_ROLE_CENTRAL
    default y

config ZMK_SPLIT_BLE_CENTRAL_PERIPHERALS
  default 2

config BT_MAX_CONN
  default 7

config BT_MAX_PAIRED
  default 7

choice ZMK_DISPLAY_STATUS_SCREEN
    default ZMK_DISPLAY_STATUS_SCREEN_CUSTOM
endchoice

config ZMK_DISPLAY_STATUS_SCREEN_CUSTOM
    select ZMK_WPM
    imply ZMK_HID_INDICATORS

choice ZMK_DISPLAY_WORK_QUEUE
    default ZMK_DISPLAY_WORK_QUEUE_DEDICATED
endchoice

config LV_Z_VDB_SIZE
	default 64
    
config LV_DPI_DEF
    default 148

config LV_Z_BITS_PER_PIXEL
    default 16

choice ST7789V_PIXEL_FORMAT
    default ST7789V_RGB565
endchoice

choice LV_COLOR_DEPTH
    default LV_COLOR_DEPTH_16
endchoice

endif

# ---------------------
# Kconfig for shield "jssplit_right" with board "nice_nano_v2"
# ---------------------
if BOARD_NICE_NANO_V2 && SHIELD_JSSPLIT_RIGHT

config I2C
    default y

#config ZMK_PIMORONI_PIM447
#    default y

config ZMK_TRACKBALL_PIM447
    default y

config ZMK_BEHAVIOR_TRACKBALL_MODE
    default y

endif
```

## config/boards/shields/JSsplit/Kconfig.shield
```kconfig
config SHIELD_CENTRAL_DONGLE
    def_bool $(shields_list_contains,central_dongle)

config SHIELD_JSSPLIT_LEFT
    def_bool $(shields_list_contains,JSsplit_left)

config SHIELD_JSSPLIT_RIGHT
    def_bool $(shields_list_contains,JSsplit_right)
```

## config/west.yml
```yaml
manifest:
  defaults:
    revision: v0.3
  remotes:
    - name: zmkfirmware
      url-base: https://github.com/zmkfirmware
    - name: joaopedropio                          # <--- add these
      url-base: https://github.com/joaopedropio   # <---
    - name: mwandzik
      url-base: https://github.com/mwandzik/
    - name: genteure
      url-base: https://github.com/Genteure  
    # Additional modules containing boards/shields/custom code can be listed here as well
    # See https://docs.zephyrproject.org/3.2.0/develop/west/manifest.html#projects
  projects:
    - name: zmk
      remote: zmkfirmware
      import: app/west.yml
    - name: snake-module                          # <--- and these
      remote: joaopedropio                        # <---
      revision: master                            # <---
      #revision: f89b9927e15f37b20f4bffa57d1489ac445ff37b     # <--- This one was working, the one above is the newest version with more boxes
    #- name: zmk-driver-pim447
      #remote: pimoroni_trackball
      #url: https://github.com/mwandzik/zmk-driver-pim447
      #revision: master
    #- name: zmk-driver-pim447
  #    remote: mwandzik
    #  url: https://github.com/mwandzik/
    #  revision: master
    - name: zmk-driver-pim447
      remote: genteure
      #revision: 38e1297f87c4a4306633356573ae8673dc7e9ecc
      revision: 3d09ddb19dbf8482d0bb67bb8f6d145c4b997685
  self:
    path: config
```
