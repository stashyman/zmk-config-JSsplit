#include "JSsplit.dtsi"

&kscan0 {
    col-gpios = <&pro_micro 5 GPIO_ACTIVE_HIGH>,
                <&pro_micro 6 GPIO_ACTIVE_HIGH>,
                <&pro_micro 7 GPIO_ACTIVE_HIGH>,
                <&pro_micro 8 GPIO_ACTIVE_HIGH>,
                <&pro_micro 9 GPIO_ACTIVE_HIGH>;
};

// == Input devices ==
// Input devices on peripheral parts
// Enabling input listeners and input-split to receive input events from peripherals
&input_split_right0 { status = "okay"; };
&input_listener_right0 { status = "okay"; };